## main/Kconfig.projbuild
```kconfig
menu "esp8266 RTOS Switch Configuration"

config WIFI_HOSTNAME
    string "WiFi HOSTNAME"
    default "switch"
    help
        The hostname for the device on your network.

config WIFI_SSID
    string "WiFi SSID"
    default "myssid"
    help
        SSID (network name) for the example to connect to.

config WIFI_PASSWORD
    string "WiFi Password"
    default "mypassword"
    help
        WiFi password (WPA or WPA2) for the example to use.
        Can be left blank if the network has no security set.

endmenu
```
